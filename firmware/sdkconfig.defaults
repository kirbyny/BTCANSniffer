## firmware/sdkconfig.defaults
```kconfig
CONFIG_BT_NIMBLE_ENABLED=y
CONFIG_BT_NIMBLE_ROLE_PERIPHERAL=y
CONFIG_BT_NIMBLE_SVC_GAP_DEVICE_NAME="BTCAN-SNIFFER"
CONFIG_BT_NIMBLE_MAX_CONNECTIONS=1
CONFIG_BTDM_CTRL_MODE_BLE_ONLY=y
CONFIG_BT_CTRL_BLE_MAX_ACT=1
CONFIG_ESP_TASK_WDT=y
CONFIG_FREERTOS_HZ=1000
```
